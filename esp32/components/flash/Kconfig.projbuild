## esp32/components/flash/Kconfig.projbuild
```kconfig
menu "Example Configuration"

config MAX_STA_CONN
    int "Max STA conn"
    default 4
    help
	Max number of the STA connects to AP.

config ESP_MAXIMUM_RETRY
    int "Maximum retry"
    default 5
    help
	Set the Maximum retry to avoid station reconnecting to the AP unlimited when the AP is really inexistent.

config PHY_ADDRESS
    int "PHY Address (0-31)"
    default 0
    range 0 31
    help
        Select the PHY Address (0-31) for the hardware configuration and PHY model.
        Note:
        Olimex EVB REV B IoT Board use PHY Address 0 and is default

config PHY_USE_POWER_PIN
    bool "Use PHY Power (enable/disable) pin"
    default n
    help
        Use a GPIO "power pin" to power the PHY on/off during operation.
        Consult the example README for more details
        Olimex ESP32 EVB REV B IoT LAN8710 Board with CAN do not use this

config PHY_POWER_PIN
    int "PHY Power GPIO"
    default 17
    depends on PHY_USE_POWER_PIN
    help
        GPIO number to use for powering on/off the PHY.

config PHY_SMI_MDC_PIN
    int "SMI MDC Pin"
    default 23
    help
        GPIO number to use for SMI clock output MDC to PHY.
        Note:
        Olimex EVB REV B IoT Board use GPIO 23 as default

config PHY_SMI_MDIO_PIN
    int "SMI MDIO Pin"
    default 18
    help
       GPIO number to use for SMI data pin MDIO to/from PHY.
       Note:
       Olimex EVB REV B IoT Board use GPIO 18 as default

    choice EXAMPLE_WEB_DEPLOY_MODE
        prompt "Website deploy mode"
        default EXAMPLE_WEB_DEPLOY_SF
        help
            Select website deploy mode.
            You can deploy website to host, and ESP32 will retrieve them in a semihost way (JTAG is needed).
            You can deploy website to SD card or SPI flash, and ESP32 will retrieve them via SDIO/SPI interface.
            Detailed operation steps are listed in the example README file.
        config EXAMPLE_WEB_DEPLOY_SEMIHOST
            bool "Deploy website to host (JTAG is needed)"
            help
                Deploy website to host.
                It is recommended to choose this mode during developing.
        config EXAMPLE_WEB_DEPLOY_SD
            depends on IDF_TARGET_ESP32
            bool "Deploy website to SD card"
            help
                Deploy website to SD card.
                Choose this production mode if the size of website is too large (bigger than 2MB).
        config EXAMPLE_WEB_DEPLOY_SF
            bool "Deploy website to SPI Nor Flash"
            help
                Deploy website to SPI Nor Flash.
                Choose this production mode if the size of website is small (less than 2MB).
    endchoice

    config EXAMPLE_WEB_MOUNT_POINT
        string "Website mount point in VFS"
        default "/www"
        help
            Specify the mount point in VFS.
endmenu
```
